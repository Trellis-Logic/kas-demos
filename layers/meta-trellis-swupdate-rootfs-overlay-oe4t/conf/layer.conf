## layers/meta-trellis-swupdate-rootfs-overlay-oe4t/conf/layer.conf
```bitbake
BBPATH := "${BBPATH}:${LAYERDIR}"
BBFILES := "${BBFILES} ${LAYERDIR}/recipes-*/*/*.bb \
           ${LAYERDIR}/recipes-*/*/*.bbappend"
```
